## comunes/Kconfig.projbuild
```kconfig
menu "Configuracion de inicializacion"

config CARGA_CONFIGURACION
	int "Carga de configuracion de fabrica"
	default 0
	help
		0 indica carga desde memoria nvs mientras que 1 indica de fabrica. 


endmenu
```

## configuracion/Kconfig.projbuild
```kconfig
menu "Configuracion General"

config CLAVE_CONFIGURACION_GENERAL
	string "Clave nvs para configuracion general"
	default "general"
	help
		Clave nvs para extraer la configuracion general

config CLAVE_PROGRAMACION
	string "Clave nvs para cargar la programacion de los dispositivos"
	default "programacion"
	help
		Clave nvs para cargar la programacion de los dispositivos

config CLAVE_PROGRAMA_ESTATICO
	string "Clave nvs para cargar el programa activo cuando arrancas de 0"
	default "programa_estatico_real"
	help
		Clave nvs para cargar el programa activo cuando arrancas de 0

config BROKER_DEFECTO
	string "Broker Mqtt"
	default "mqtt://jajicaiot.ddns.net"
	help
		Servidor Mqtt
		
config PUERTO_DEFECTO
	int "Puerto Mqtt"
	default 1883
	help
		Puerto Mqtt
		
config USUARIO_BROKER_DEFECTO
	string "Usuario broker"
	default ""
	help
		Usuario de acceso al servidor Mqtt

config PASSWORD_BROKER_DEFECTO
	string "Password broker"
	default ""
	help
		Password de acceso al servidor Mqtt

config MQTT_TLS
        int "habilita conexion segura"
        default 0
        help
            Habilita conexion segura para el servidor mqtt.
	
config PREFIJO_SUSCRIPCION_DEFECTO
	string "prefijo para los topics usados"
	default "/"
	help
		Los topics de suscripcion y publicacion tendran este prefijo

	
config NAMESPACE
	string "Espacio de nombre configuracion"
	default "CONF_DISP"
	help
		Espacio de nombres nvs usado para la configuracion general.
		
config TAMANO_BUFFER_LECTURA
	int "Tamano del buffer de lectura"
	default 1024
	help
		Es el tamano de buffer para leer datos en nvs y enviarlos por mqtt


endmenu
```

## ds18x20/Kconfig.projbuild
```kconfig
menu "Configuracion DS18B20"


config GPIO_PIN_DS18B20
	int "Pin gpio del sensor DS18B20"
	default 2
	help 
		Indica el pin gpio que se usa para el sensor

endmenu
```

## espota/Kconfig.projbuild
```kconfig
menu "Configuracion otaesp"

config SERVER_IP
    string "HTTP Server IP"
        default "jajicaiot.ddns.net/firmware/iotOnOff"
        help
                HTTP Server IP to download the image file from.

                See example README.md for details.

config SERVER_PORT
        string "HTTP Server Port"
        default "80"
        help
                HTTP Server port to connect to.
                Should be chosen not to conflict with any other port used
                on the system.

config MEMORIA_ESP8266
        int "Cantidad de memoria del esp8266 0 1Mb, 1 > 2Mb"
        default 1
        help
                Parametro que se utiliza para hacer el upgrade de la aplicacion segun la memoria del esp8266

endmenu
```

## programador/Kconfig.projbuild
```kconfig
menu "Configuracion ntp"

config TIMEOUT_NTP
	int "tiempo espera peticion ntp"
	default 5000
	help
		Es el tiempo de espera a que el servidor ntp responda

config SERVIDOR_NTP
	string "Servidor ntp"
	default "pool.ntp.org"
	help
		Es el servidor ntp usado en la aplicacion.

endmenu
```
